## config/west.yml
```yaml
manifest:
  remotes:
    - name: zmkfirmware
      url-base: https://github.com/zmkfirmware
    - name: sayu-hub
      url-base: https://github.com/sayu-hub
    - name: Dist16384
      url-base: https://github.com/Dist16384
    - name: caksoylar
      url-base: https://github.com/caksoylar
    - name: zettaface
      url-base: https://github.com/zettaface

  projects:
    - name: zmk
      remote: zettaface
      revision: main
      path: zmk
      import: app/west.yml

    - name: zmk-pmw3610-driver
      remote: Dist16384
      revision: main
      path: modules/zmk-pmw3610-driver

    - name: zmk-rgbled-widget
      remote: caksoylar
      revision: v0.3

    - name: zmk-input-processor-keybind
      remote: zettaface
      revision: main
      path: modules/zmk-input-processor-keybind

  self:
    path: config
```
